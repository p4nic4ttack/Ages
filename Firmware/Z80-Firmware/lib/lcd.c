#include <lcd.h>

const uint8_t ascii[576] = {
0x00, 0x00, 0x00, 0x00, 0x00, 0x00,
0x00, 0x00, 0x5f, 0x00, 0x00, 0x00,
0x00, 0x07, 0x00, 0x07, 0x00, 0x00,
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0x00, 0x00, 0x02, 0x05, 0x02, 0x00
};

uint8_t *SPI_CE = 0x21b;
uint8_t *SPI_CLK = 0x218;
uint8_t *SPI_DOUT = 0x219;
uint8_t *SPI_DC = 0x21a;
uint8_t *SPI_RST = 0x21c;

void init_lcd(void){
  *SPI_CE = 1;
  delay10us();
  *SPI_RST = 1;
  delay10us();
  lcd_command_byte(0x21);
  lcd_command_byte(0x04);
  lcd_command_byte(0x14);
  lcd_command_byte(0xc0);
  lcd_command_byte(0x20);
  lcd_command_byte(0x0c);
  lcd_out_char(0xff);
}

void set_x(int x){
  if(x >= 0 && x < 84){
    x |= (1<<7);
    lcd_command_byte(x);
  }
}

void set_y(int y){
  if(y >= 0 && y < 6){
    y &= ~(1<<7);
    y |= (1<<6);
    y &= ~(1<<5);
    y &= ~(1<<4);
    y &= ~(1<<3);
    lcd_command_byte(y);
  }
}

void lcd_out_char(uint8_t chr){
  if(chr != 0xff){
    uint16_t idx = 6*(chr - 0x20);
    for(uint8_t i = 0; i < 6; i++){
      uint8_t character = ascii[idx + i];
      lcd_data_byte(character);
    }
  }else{
    set_x(0x00);
    set_y(0x00);
    for(uint16_t i = 0; i < 504; i++){
      lcd_data_byte(0x00);
    }
    set_x(0x00);
    set_y(0x00);
  }
}

void lcd_command_byte(uint8_t val){
  *SPI_CE = 0;
  delay10us();
  *SPI_DC = 0;
  for(uint8_t i = 0; i < 8; i++){
    if(val & (1<<7-i)){
      *SPI_DOUT = 1;
    }else{
      *SPI_DOUT = 0;
    }
    *SPI_CLK = 0;
    *SPI_CLK = 1;
  }
  *SPI_CE = 1;
}

void lcd_data_byte(uint8_t val){
  *SPI_CE = 0;
  delay10us();
  *SPI_DC = 1;
  for(uint8_t i = 0; i < 8; i++){
    if(val & (1<<7-i)){
      *SPI_DOUT = 1;
    }else{
      *SPI_DOUT = 0;
    }
    *SPI_CLK = 0;
    *SPI_CLK = 1;
  }
  *SPI_CE = 1;
}


void lcd_out_str(uint8_t str[], uint8_t x, uint8_t y){
  set_x(x);
  set_y(y);
  for(int i = 0; i < strlen(str); i++){
    lcd_out_char((uint8_t)str[i]);
  }
}

void lcd_draw(const uint8_t array[],uint8_t x,uint8_t y,uint16_t size){
  set_x(x);
  set_y(y);
  for(uint16_t i = 0; i < size; i++){
    lcd_data_byte(array[i]);
  }
}