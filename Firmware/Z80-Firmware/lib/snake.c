#include <snake.h>
#include <stdio.h>

const uint8_t snake_img[] = {0x00, 0x00, 0x00, 0x00, 0x00, 0x00, 0x00, 0x00, 0x80, 0x80, 0xc0, 0xc0, 0xe0,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 0x00, 0x00};

void init_snake(Snake *snake, Food *food){
  snake->length = 1;
  snake->prev_length = 1;
  snake->body[0].x = MATRIX_SIZE / 2;
  snake->body[0].y = MATRIX_SIZE / 2;
  snake->direction = D_RIGHT;
  snake->game_over = false;
  food->active = false;
  snake->update_lvl = false;
}

void main_snake_loop(){
  Snake snake;
  Food food;
  init_snake(&snake,&food);
  lcd_draw(snake_img, 0, 0, 504);
  while(!snake.game_over){
    clear_framebuffer();
    get_input(&(snake.direction));
    move_snake(&snake);
    draw_board(&snake, &food);
    if (snake.body[0].x == food.position.x && snake.body[0].y == food.position.y) {
      snake.length++;
      food.active = false;
    }
    if(!food.active){
      place_food(&food, &snake);
    }

    if (check_collision(&snake)){

      snake.game_over = true;
    }

    uint16_t wait_time = 150;
    if(snake.length >= 15){
      wait_time = 250;
      snake.update_lvl = true;
    }
    else if(snake.length >= 25){
      snake.update_lvl = true;
      wait_time = 350;
    }
    else if(snake.length >= 35){
      snake.update_lvl = true;
      wait_time = 450;
    }

    if(snake.length > snake.prev_length){
      if(snake.prev_length == 1){
        lcd_out_char(0xff);
        lcd_out_str("~~~LEVEL~~~",10, 0);
        lcd_out_str("1", 39, 1);
        lcd_out_str("~~~~~~~~~~~", 10, 2);
        lcd_out_str("Score: ", 20, 3);
        lcd_out_str("~~~~~~~~~~~", 10, 4);
      }
      char score_str[4];
      sprintf(score_str, "%d", snake.length);
      lcd_out_str(score_str, 60, 3);
      snake.prev_length = snake.length;
    }
    if(snake.update_lvl == true){
      if(wait_time == 250)
        lcd_out_str("2", 39, 1);
      else if(wait_time == 350)
        lcd_out_str("3", 39, 1);
      else if(wait_time == 450)
        lcd_out_str("4", 39, 1);
      snake.update_lvl = false;
    }
    for(uint16_t i = 0; i < wait_time-(snake.length*10); i++){
      delay1ms();
    }
  }
}

void draw_board(const Snake *snake, const Food *food) {
  for (uint8_t i = 0; i < MATRIX_SIZE; i++) {
    for (uint8_t j = 0; j < MATRIX_SIZE; j++) {
        if (i == food->position.y && j == food->position.x) {
          set_pixel(j,i);
        }
        else if (i == snake->body[0].y && j == snake->body[0].x) {
          set_pixel(j,i);
        }
        else {
          bool isSnakeBody = false;
          for (int k = 1; k < snake->length; k++) {
            if (i == snake->body[k].y && j == snake->body[k].x) {
              set_pixel(j,i);
              isSnakeBody = true;
              break;
            }
          }
          if (!isSnakeBody) {
            unset_pixel(j,i);
          }
        }
    }
  }
  update_framebuffer(framebuffer);
}

void get_input(Direction *direction){
  ButtonState up = up_pressed();
  ButtonState dwn = dwn_pressed();
  ButtonState lft = lft_pressed();
  ButtonState rgt = rgt_pressed();
  if(dwn == BTN_PRESSED || dwn == BTN_HOLD){
    if(*direction != D_UP)
      *direction = D_DOWN;
  }
  if(up == BTN_PRESSED || up == BTN_HOLD){
    if(*direction != D_DOWN)
      *direction = D_UP;
  }if(lft == BTN_PRESSED || lft == BTN_HOLD){
    if(*direction != D_LEFT)
      *direction = D_RIGHT;
  }if(rgt == BTN_PRESSED || rgt == BTN_HOLD){
    if(*direction != D_RIGHT)
      *direction = D_LEFT;
  }
}

void move_snake(Snake *snake){
  for (uint8_t i = snake->length - 1; i > 0; i--) {
    snake->body[i] = snake->body[i - 1];
  }
  switch(snake->direction){
    case D_UP:
      snake->body[0].y--;
      break;
    case D_DOWN:
      snake->body[0].y++;
      break;
    case D_LEFT:
      snake->body[0].x--;
      break;
    case D_RIGHT:
      snake->body[0].x++;
      break;
  }
}


bool check_collision(const Snake *snake){
  int headX = snake->body[0].x;
  int headY = snake->body[0].y;

  if (headX < 0 || headX >= MATRIX_SIZE || headY < 0 || headY >= MATRIX_SIZE) {
    return true; // Hit the wall
  }

  for (uint8_t i = 1; i < snake->length; i++) {
    if (snake->body[i].x == headX && snake->body[i].y == headY) {
      return true; // Collided with itself
    }
  }

  return false;
}

void place_food(Food *food, const Snake *snake){
  int x, y;
  do {
    x = rand() % MATRIX_SIZE;
    y = rand() % MATRIX_SIZE;
  } while (snake->body[0].x == x && snake->body[0].y == y);
  food->position.x = x;
  food->position.y = y;
  food->active = true;
}